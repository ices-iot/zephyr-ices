## boards/arm/zices_mesh/Kconfig.board
```kconfig
#
# Code based on nrf52840_pca10059.
# Base commit: ef935898d0bb7eb45f464650d79a264b2c3b0e98
# Edited by ZICES contributors.
#

# Kconfig - ZICES Mesh board configuration
#
# Copyright (c) 2022 ICES
# Copyright (c) 2018 Nordic Semiconductor ASA
#
# SPDX-License-Identifier: Apache-2.0

config  BOARD_KNOT_MESH
	bool "ZICES MESH"
	depends on SOC_NRF52840_QIAA
```
